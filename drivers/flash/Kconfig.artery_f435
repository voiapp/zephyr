## drivers/flash/Kconfig.artery_f435
```kconfig
# Artery AT32F435 internal flash configuration

# Copyright (c) 2026 Voi Technology AB
# SPDX-License-Identifier: Apache-2.0

config SOC_FLASH_ARTERY_F435
	bool "Artery AT32F435 internal flash driver"
	depends on DT_HAS_ARTERY_F435_FLASH_CONTROLLER_ENABLED
	select FLASH_HAS_DRIVER_ENABLED
	select FLASH_HAS_PAGE_LAYOUT
	select FLASH_HAS_EXPLICIT_ERASE
	help
	  Enable the internal flash driver for Artery AT32F435 microcontrollers.
	  This driver provides erase, write, and read operations for the on-chip
	  flash memory. The AT32F435 features two flash banks with 4 KiB sector
	  erase granularity and 32-bit write alignment.
```

## drivers/flash/Kconfig.artery_f435_qspi
```kconfig
# Copyright (c) 2026
# SPDX-License-Identifier: Apache-2.0

config FLASH_ARTERY_F435_QSPI
	bool "Artery AT32F435 QSPI NOR flash driver"
	depends on DT_HAS_ARTERY_F435_QSPI_NOR_ENABLED
	select FLASH_HAS_DRIVER_ENABLED
	select FLASH_HAS_PAGE_LAYOUT
	select FLASH_JESD216
	help
	  Enable the Artery AT32F435 QSPI NOR flash driver.

	  This driver provides support for external QSPI NOR flash memory
	  connected to the AT32F435 QSPI peripheral. It uses JESD216/SFDP
	  for automatic flash geometry detection and supports quad I/O mode.
```

## drivers/modem/Kconfig.cellular
```kconfig
# Copyright (c) 2023 Bjarki Arge Andreasen
# SPDX-License-Identifier: Apache-2.0

config MODEM_CELLULAR
	bool "Generic cellular modem support"
	select MODEM_MODULES
	select MODEM_PPP
	select MODEM_CMUX
	select MODEM_CHAT
	select MODEM_PIPE
	select MODEM_PIPELINK
	select MODEM_BACKEND_UART
	select UART_USE_RUNTIME_CONFIGURE
	select RING_BUFFER
	select NET_L2_PPP_OPTION_MRU
	select NET_L2_PPP_PAP
	select NET_L2_PPP_MGMT
	depends on (DT_HAS_QUECTEL_BG95_ENABLED || DT_HAS_QUECTEL_BG96_ENABLED || \
				DT_HAS_SIMCOM_A76XX_ENABLED || DT_HAS_SIMCOM_SIM7080_ENABLED || \
				DT_HAS_U_BLOX_SARA_R4_ENABLED || DT_HAS_U_BLOX_SARA_R5_ENABLED || \
				DT_HAS_SWIR_HL7800_ENABLED || DT_HAS_TELIT_ME910G1_ENABLED || \
				DT_HAS_TELIT_ME310G1_ENABLED || DT_HAS_QUECTEL_EG25_G_ENABLED || \
				DT_HAS_NORDIC_NRF91_SLM_ENABLED || DT_HAS_SQN_GM02S_ENABLED || \
				DT_HAS_U_BLOX_LARA_R6_ENABLED || DT_HAS_QUECTEL_EG800Q_ENABLED)
	select MODEM_CMUX_DEFAULT_MTU_127 if \
		(DT_HAS_QUECTEL_BG95_ENABLED || DT_HAS_QUECTEL_BG96_ENABLED || \
		 DT_HAS_QUECTEL_EG25_G_ENABLED || DT_HAS_SIMCOM_SIM7080_ENABLED || \
		 DT_HAS_U_BLOX_SARA_R4_ENABLED || DT_HAS_U_BLOX_SARA_R5_ENABLED || \
		 DT_HAS_SWIR_HL7800_ENABLED || DT_HAS_TELIT_ME910G1_ENABLED || \
		 DT_HAS_TELIT_ME310G1_ENABLED || DT_HAS_SQN_GM02S_ENABLED || \
		 DT_HAS_QUECTEL_EG800Q_ENABLED || DT_HAS_SIMCOM_A76XX_ENABLED)
	help
	  This driver uses the generic 3gpp AT commands, along
	  with the standard protocols CMUX and PPP, to configure
	  cellular modems to establish a point-to-point
	  network connection. It is a template for tailored
	  drivers for the ublox, quectel and other modems, which
	  include power management and more complex device specific
	  features.

if MODEM_CELLULAR

config MODEM_CELLULAR_INIT_PRIORITY
	int "Cellular modem driver initialization priority"
	default 79
	range 0 99
	help
	  Driver initialization priority for cellular modem drivers.
	  Defaults to less than GNSS_INIT_PRIORITY, as LTE modems often
	  integrate a GNSS modem.

config MODEM_CELLULAR_APN
	string "Static APN"
	default "internet"
	help
	  If left empty the driver will wait for the application to call
	  cellular_set_apn() before it proceeds to the dial phase.

config MODEM_CELLULAR_PERIODIC_SCRIPT_MS
	int "Periodic script interval in milliseconds"
	default 2000

config MODEM_CELLULAR_UART_BUFFER_SIZES
	int "The UART receive and transmit buffer sizes in bytes."
	default 512

config MODEM_CELLULAR_CHAT_BUFFER_SIZE
	int "The size of the buffer used for the chat scripts in bytes."
	default 128

config MODEM_CELLULAR_USER_PIPE_BUFFER_SIZES
	int "The size of the buffers used for each user pipe in bytes."
	default 128

config MODEM_CELLULAR_NEW_BAUDRATE
	int "New baudrate to configure modem to, if supported"
	range 9600 4000000
	default 3000000 if DT_HAS_U_BLOX_LARA_R6_ENABLED
	default 115200

config MODEM_CELLULAR_NEW_BAUDRATE_DELAY
	int "Time modem takes to change baudrate, in milliseconds"
	range 0 1000
	default 100 if DT_HAS_U_BLOX_LARA_R6_ENABLED
	default 300

config MODEM_CELLULAR_RESET_POWER_ON_DELAY_MS
	int "Delay between de-asserting the reset pin and pulsing the power pin"
	default 500

config MODEM_CELLULAR_AWAIT_POWER_ON_TIMEOUT_MS
	int "Timeout in ms for APP RDY before falling back to AT probe"
	default 30000
	help
	  If APP RDY is not received within this time, the driver sends AT and
	  proceeds if it gets OK. Ensures the modem can recover when APP RDY
	  was missed (e.g. sent before pipe opened).

config MODEM_CELLULAR_AWAIT_POWER_ON_PROBE_RETRIES
	int "Max AT probe retries when APP RDY times out"
	default 3
	help
	  When APP RDY times out, the driver probes with AT. If the probe
	  fails, it retries up to this many times before proceeding anyway.

if DT_HAS_U_BLOX_LARA_R6_ENABLED

choice MODEM_CELLULAR_RAT
	prompt "Which Radio Access Technology to use"
	default MODEM_CELLULAR_RAT_4G

config MODEM_CELLULAR_RAT_4G
	bool "Use only 4G"

config MODEM_CELLULAR_RAT_4G_3G
	bool "Use 4G & 3G"

config MODEM_CELLULAR_RAT_4G_3G_2G
	bool "Use 4G, 3G & 2G"

endchoice

config MODEM_CELLULAR_CLEAR_FORBIDDEN
	bool "Clear forbidden networks from SIM-card on boot"

endif #DT_HAS_U_BLOX_LARA_R6_ENABLED

if DT_HAS_QUECTEL_BG95_ENABLED || DT_HAS_QUECTEL_BG96_ENABLED

config MODEM_CELLULAR_BG9X_DYNAMIC_APN
	bool "Dynamic APN selection based on SIM ICCID for BG9x modems"
	default n
	help
	  Enable runtime APN selection for the Quectel BG95/BG96 based on the SIM
	  card ICCID prefix. This is required on boards that may be equipped with
	  SIM cards from different providers (e.g. Tele2 and Arkessa/Wireless Logic).
	  The ICCID is read from the modem during initialization and compared against
	  a configurable prefix. When the prefix matches, a provider-specific APN is
	  used instead of the value from CONFIG_MODEM_CELLULAR_APN.

if MODEM_CELLULAR_BG9X_DYNAMIC_APN

config MODEM_CELLULAR_BG9X_TELE2_ICCID_MASK
	string "ICCID prefix identifying Tele2 SIM cards"
	default "894620"
	help
	  SIM cards whose ICCID starts with this prefix are treated as Tele2 SIMs.
	  When a match is found the driver switches to CONFIG_MODEM_CELLULAR_BG9X_APN_TELE2
	  for the PDP context instead of the default CONFIG_MODEM_CELLULAR_APN.

config MODEM_CELLULAR_BG9X_APN_TELE2
	string "APN to use for Tele2 SIM cards"
	default "m2m.tele2.com"
	help
	  APN string used when the SIM ICCID matches CONFIG_MODEM_CELLULAR_BG9X_TELE2_ICCID_MASK.

endif # MODEM_CELLULAR_BG9X_DYNAMIC_APN

endif # DT_HAS_QUECTEL_BG95_ENABLED || DT_HAS_QUECTEL_BG96_ENABLED

if DT_HAS_QUECTEL_EG800Q_ENABLED

config MODEM_CELLULAR_QUECTEL_EG800Q_GOLDENEYE_SCRIPT
	bool "Use Goldeneye-specific modem chat script for Quectel EG800Q"
	help
	  Enable the Goldeneye-specific modem initialization and dial scripts
	  for Quectel EG800Q. This includes dual PDP context support (IoT platform
	  over PPP and CV connection over USB ECM), USB net mode configuration,
	  NAT setup, and enhanced registration checks. Leave disabled for basic
	  EG800Q operation without these features.

if MODEM_CELLULAR_QUECTEL_EG800Q_GOLDENEYE_SCRIPT

config MODEM_CELLULAR_QUECTEL_EG800Q_GOLDENEYE_CV_APN
	string "APN for the second PDP context (CV over USB ECM) on Goldeneye"
	default "voi.cv.stage.tele2.com"
	help
	  APN string used for the second PDP context (bearer 2) which carries
	  the CV connection over USB ECM mode on Goldeneye hardware. This is
	  distinct from the primary IoT-platform APN set by CONFIG_MODEM_CELLULAR_APN.

endif # MODEM_CELLULAR_QUECTEL_EG800Q_GOLDENEYE_SCRIPT

endif #DT_HAS_QUECTEL_EG800Q_ENABLED

endif #MODEM_CELLULAR
```

## dts/bindings/flash_controller/artery,f435-flash-controller.yaml
```yaml
description: Artery AT32F435 flash controller

compatible: "artery,f435-flash-controller"

include: flash-controller.yaml
```

## dts/bindings/flash_controller/artery,f435-qspi-nor.yaml
```yaml
# Copyright (c) 2026
# SPDX-License-Identifier: Apache-2.0

description: |
    Artery AT32F435 QSPI Flash controller supporting the JEDEC CFI interface

    Representation of a serial flash on a quadspi bus:

        external_flash: w25q512jveiq@0 {
                compatible = "artery,f435-qspi-nor";
                reg = <0>;
                size = <DT_SIZE_M(512)>; /* 512 Mbits */
                qspi-max-frequency = <50000000>;
                jedec-id = [ef 40 20];
                spi-bus-width = <4>;
                status = "okay";
        };

compatible: "artery,f435-qspi-nor"

include: ["flash-controller.yaml", "jedec,jesd216.yaml"]

on-bus: qspi

properties:
  size:
    required: true
    description: Flash Memory size in bits (following Zephyr QSPI NOR convention)
  reg:
    required: true
    description: Chip select number (typically 0)
  qspi-max-frequency:
    type: int
    required: true
    description: Maximum clock frequency of device's QSPI interface in Hz
  reset-gpios:
    type: phandle-array
    description: RESETn pin
  reset-gpios-duration:
    type: int
    description: The duration (in ms) for the flash memory reset pulse
  spi-bus-width:
    type: int
    description: |
      The width of (Q)SPI bus to which flash memory is connected.
      Typical value is 4 (when using SIO[0123] for quad mode).
```

## dts/bindings/modem/quectel,eg25-g.yaml
```yaml
description: Quectel EG25-G modem

compatible: "quectel,eg25-g"

include: zephyr,cellular-modem-device.yaml

properties:
  mdm-reset-gpios:
    type: phandle-array
    required: true

  mdm-dtr-gpios:
    type: phandle-array

  mdm-wdisable-gpios:
    type: phandle-array

  zephyr,mdm-reset-behavior:
    default: ["toggle_on_recovery"]

  autostarts:
    type: boolean
    description: |
      Set when the module starts automatically when supply voltage is applied,
      or when the host application manages the power-on sequence externally
      (e.g. via a board-level PWRKEY pulse before modem_cellular_init runs).
      Causes modem_cellular to skip its own power-on/reset pulse and go
      directly to AWAIT_POWER_ON.
```

## dts/bindings/modem/quectel,eg800q.yaml
```yaml
description: Quectel EG800Q modem

compatible: "quectel,eg800q"

include: zephyr,cellular-modem-device.yaml

properties:
  mdm-power-gpios:
    type: phandle-array
    required: false

  zephyr,mdm-reset-behavior:
    default: ["toggle_on_recovery"]

  vin-supply:
    type: phandle
    description: |
      Regulator supplying the modem VIN/VBAT power rail.
```

## dts/bindings/modem/simcom,a76xx.yaml
```yaml
# Copyright (C) 2025 Olivier Lalonde
# SPDX-License-Identifier: Apache-2.0

description: Simcom A76XX modem

compatible: "simcom,a76xx"

include: zephyr,cellular-modem-device.yaml

properties:
  vin-supply:
    type: phandle
    description: |
      Regulator supplying the modem VIN/VBAT power rail.
      When present, the modem power management can use regulator_enable/
      regulator_disable for power sequencing instead of or in addition to
      mdm-power-gpios.

  mdm-power-gpios:
    type: phandle-array
    required: true
```

## dts/bindings/mtd/artery,f435-nv-flash.yaml
```yaml
description: Artery AT32F435 non-volatile flash memory

compatible: "artery,f435-nv-flash"

include: soc-nv-flash.yaml
```

## dts/bindings/qspi/artery,f435-qspi.yaml
```yaml
# Copyright (c) 2026
# SPDX-License-Identifier: Apache-2.0

description: |
    Artery AT32F435 QSPI Controller.

    An AT32F435 quadspi node would typically look like this:

        &quadspi {
            pinctrl-0 = <&quadspi_bk1_clk_pb1 &quadspi_bk1_ncs_pb10
                         &quadspi_bk1_io0_pa6 &quadspi_bk1_io1_pa7
                         &quadspi_bk1_io2_pc4 &quadspi_bk1_io3_pc5>;
            pinctrl-names = "default";
            status = "okay";
        };

compatible: "artery,f435-qspi"

include: [base.yaml, pinctrl-device.yaml]

bus: qspi

properties:
  reg:
    required: true

  interrupts:
    required: false

  clocks:
    required: true

  pinctrl-0:
    required: true

  pinctrl-names:
    required: true

  dmas:
    description: |
      Optional DMA channel specifier. If DMA should be used, specifier should
      hold a phandle reference to the dma controller, the channel number,
      the slot number, channel configuration and finally features.

      For example dmas for TX/RX on QSPI
         dmas = <&dma1 5 5 0x0000 0x03>;

  dma-names:
    description: |
      DMA channel name. If DMA should be used, expected value is "tx_rx".

      For example
         dma-names = "tx_rx";

  flash-id:
    type: int
    required: false
    description: |
      Flash ID number. This number, if defined, helps to select the right
      QSPI GPIO banks (defined as 'quadspi_bk[12]' in pinctrl property)
      to communicate with flash memory.

      For example
         flash-id = <2>;
```

## dts/bindings/spi/st,stm32-spi-common.yaml
```yaml
# Copyright (c) 2018, I-SENSE group of ICCS
# SPDX-License-Identifier: Apache-2.0

# Common fields for STM32 SPI peripherals.

include: [spi-controller.yaml, pinctrl-device.yaml]

properties:
  reg:
    required: true

  interrupts:
    required: true

  pinctrl-0:
    required: true

  pinctrl-names:
    required: true

  ioswp:
    type: boolean
    description: Swap SPI MOSI and MISO pins

  st,spi-data-width:
    type: string
    enum:
      - "full-4-to-32-bit"
      - "full-4-to-16-bit"
      - "limited-8-16-bit"
    description: |
      Data width capability of the SPI peripheral.
        full-4-to-32-bit: Supports 4 to 32-bit data sizes (e.g. STM32H7/H5/U5 style).
        full-4-to-16-bit: Supports 4 to 16-bit data sizes (e.g. STM32F4 FIFO style).
        limited-8-16-bit: Only 8-bit or 16-bit data sizes (e.g. classic STM32F1 style).

  st,soft-nss:
    type: boolean
    description: |
      Enable software NSS management. When set, the NSS pin is driven by
      software rather than the SPI hardware NSS signal.
```

## dts/bindings/spi/st,stm32h7-spi.yaml
```yaml
# Copyright (c) 2022, Linaro Limited
# SPDX-License-Identifier: Apache-2.0

description: |
        STM32H7 SPI controller.

        This compatible stands for all SPI hardware blocks matching the
        version available in STM32H7 SoCs.
        This version of STM32 SPI hardware block could be identified by the
        presence of a dedicated interrupt enable register (IER).
        For instance, but not limited  to: STM32MP1, STM32U5

compatible: "st,stm32h7-spi"

include: st,stm32-spi-common.yaml

properties:
  midi-clock:
    type: int
    default: 0
    description: |
      (Master Inter-Data Idleness) minimum clock inserted
      between two consecutive data frames.

  mssi-clock:
    type: int
    default: 0
    description: |
      (Master SS Idleness) minimum clock inserted between
      start and first data transaction.

  fifo-enable:
    type: boolean
    description: Enable the SPI FIFO usage for performance improvement.

  st,spi-data-width:
    default: "full-4-to-32-bit"

  fifo-size:
    type: int
    default: 16
    description: |
      SPI FIFO depth in bytes. Used to compute the FIFO threshold watermark
      for interrupt-driven transfers. Default is 16 bytes (STM32H7/H5/U5).

  fifo-max-transfer-size:
    type: int
    default: 65535
    description: |
      Maximum number of SPI frames per transfer (TSIZE register limit).
      Transfers exceeding this value will return an error. The 16-bit TSIZE
      register in STM32H7/H5-style SPI limits this to 65535.
```
